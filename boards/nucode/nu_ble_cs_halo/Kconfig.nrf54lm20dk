## boards/nucode/nu_ble_cs_halo/Kconfig.nrf54lm20dk
```kconfig
# SPDX-License-Identifier: Apache-2.0
config BOARD_NRF54LM20DK
	select SOC_NRF54LM20B_CPUAPP if BOARD_NRF54LM20DK_NRF54LM20B_CPUAPP_NU_BLE_CS_HALO
```

## boards/nucode/nu_ble_cs_halo/board.yml
```yaml
# SPDX-License-Identifier: Apache-2.0
board:
  extend: nrf54lm20dk
  variants:
    - name: nu_ble_cs_halo
      qualifier: nrf54lm20b/cpuapp

runners:
  priority: 20
  run_once:
    '--recover':
      - runners: [nrfutil]
        run: first
        groups: &halo_groups
          - boards: [nrf54lm20dk/nrf54lm20b/cpuapp/nu_ble_cs_halo]
    '--erase':
      - runners: [jlink, nrfutil]
        run: first
        groups: *halo_groups
    '--reset':
      - runners: [jlink, nrfutil]
        run: last
        groups: *halo_groups
```

## boards/nucode/nu_ble_cs_halo/nrf54lm20dk_nrf54lm20b_cpuapp_nu_ble_cs_halo_defconfig
```kconfig
# Copyright (c) 2026 Nordic Semiconductor ASA
# SPDX-License-Identifier: Apache-2.0

CONFIG_ARM_MPU=y
CONFIG_NULL_POINTER_EXCEPTION_DETECTION_NONE=y
CONFIG_CACHE_MANAGEMENT=y
CONFIG_EXTERNAL_CACHE=y
CONFIG_NRF_GRTC_START_SYSCOUNTER=y
CONFIG_GPIO=y
CONFIG_SERIAL=y
CONFIG_CONSOLE=y
CONFIG_UART_CONSOLE=y
CONFIG_USB_DEVICE_STACK_NEXT=y
CONFIG_CDC_ACM_SERIAL_INITIALIZE_AT_BOOT=y
CONFIG_CDC_ACM_SERIAL_MANUFACTURER_STRING="NUCODE"
CONFIG_CDC_ACM_SERIAL_PRODUCT_STRING="NU BLE CS HALO"
```
